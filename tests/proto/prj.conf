## CMakeLists.txt
```
cmake_minimum_required(VERSION 3.20.0)
find_package(Zephyr REQUIRED HINTS $ENV{ZEPHYR_BASE})
project(batmon_proto_test LANGUAGES C)

set(BATMON_ROOT ${CMAKE_CURRENT_SOURCE_DIR}/../..)

target_include_directories(app PRIVATE src ${BATMON_ROOT}/src/proto ${BATMON_ROOT}/tests/common)
target_sources(app PRIVATE
  src/main.c
  ${BATMON_ROOT}/src/proto/bm_proto.c
  ${BATMON_ROOT}/src/proto/bm_json.c
  ${BATMON_ROOT}/src/proto/bm_ydt.c
  ${BATMON_ROOT}/src/proto/bm_serial.c
  ${BATMON_ROOT}/tests/common/test_cases.c
  ${BATMON_ROOT}/tests/common/test_serial.c
)
```

## prj.conf
```kconfig
CONFIG_ZTEST=y
CONFIG_MAIN_STACK_SIZE=8192
CONFIG_ZTEST_STACK_SIZE=8192
```

## src/main.c
```c
#include <zephyr/ztest.h>

#include "test_cases.h"

ZTEST_SUITE(batmon_proto, NULL, NULL, NULL, NULL, NULL);

ZTEST(batmon_proto, test_pylontech_original)
{
	test_pylontech_original();
}

ZTEST(batmon_proto, test_emulation_and_vendors)
{
	test_emulation_and_vendors();
}

ZTEST(batmon_proto, test_victron_extension)
{
	test_victron_extension();
}

ZTEST(batmon_proto, test_sma_dialect)
{
	test_sma_dialect();
}

ZTEST(batmon_proto, test_pylon_hv)
{
	test_pylon_hv();
}

ZTEST(batmon_proto, test_inverter_and_unknown)
{
	test_inverter_and_unknown();
}

ZTEST(batmon_proto, test_id_table_overflow)
{
	test_id_table_overflow();
}

ZTEST(batmon_proto, test_ydt_frames)
{
	test_ydt_frames();
}

ZTEST(batmon_proto, test_serial_pylontech)
{
	test_serial_pylontech();
}

ZTEST(batmon_proto, test_serial_seplos)
{
	test_serial_seplos();
}

ZTEST(batmon_proto, test_serial_pace_state_machine)
{
	test_serial_pace_state_machine();
}

ZTEST(batmon_proto, test_serial_jk)
{
	test_serial_jk();
}

ZTEST(batmon_proto, test_serial_modbus)
{
	test_serial_modbus();
}

ZTEST(batmon_proto, test_serial_sniff)
{
	test_serial_sniff();
}
```

## src/check.h
```c
#ifndef BATMON_ZTEST_CHECK_H
#define BATMON_ZTEST_CHECK_H

#include <zephyr/ztest.h>

#define CHECK(cond) zassert_true((cond), "%s", #cond)

#endif
```
